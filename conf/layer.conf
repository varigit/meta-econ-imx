## conf/layer.conf
```bitbake
# We have a conf and classes directory, add to BBPATH
BBPATH .= ":${LAYERDIR}"

# We have recipes-* directories, add to BBFILES
BBFILES += "${LAYERDIR}/recipes-*/*/*.bb \
         ${LAYERDIR}/recipes-*/*/*.bbappend"

BBFILE_COLLECTIONS += "econ-imx8"
BBFILE_PATTERN_econ-imx8 = "^${LAYERDIR}/"
BBFILE_PRIORITY_econ-imx8 = "50"
LAYERVERSION_econ-imx8 = "1"
LAYERSERIES_COMPAT_econ-imx8 = "dunfell"

# Override/extend machine configurations

KERNEL_DEVICETREE_append_imx8mm-var-dart = " \
	freescale/imx8mm-var-dart-dt8mcustomboard-econ-camera.dtb \
	freescale/imx8mm-var-dart-dt8mcustomboard-legacy-econ-camera.dtb \
	freescale/imx8mm-var-som-symphony-econ-camera.dtb \
	freescale/imx8mm-var-som-symphony-legacy-econ-camera.dtb \
"
```
